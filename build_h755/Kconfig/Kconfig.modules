## build_h755/Kconfig/soc/Kconfig.sysbuild
```kconfig
# Load Sysbuild SoC Kconfig descriptions.
osource "/Users/vzein/Projects/spikes/zephyr/soc/xlnx/zynqmp/Kconfig.sysbuild"
osource "/Users/vzein/Projects/spikes/zephyr/soc/xlnx/zynq7000/Kconfig.sysbuild"
osource "/Users/vzein/Projects/spikes/zephyr/soc/xlnx/versalnet/Kconfig.sysbuild"
osource "/Users/vzein/Projects/spikes/zephyr/soc/xlnx/versal2/Kconfig.sysbuild"
osource "/Users/vzein/Projects/spikes/zephyr/soc/xen/Kconfig.sysbuild"
osource "/Users/vzein/Projects/spikes/zephyr/soc/wch/ch32v/Kconfig.sysbuild"
osource "/Users/vzein/Projects/spikes/zephyr/soc/ti/simplelink/Kconfig.sysbuild"
osource "/Users/vzein/Projects/spikes/zephyr/soc/ti/mspm0/Kconfig.sysbuild"
osource "/Users/vzein/Projects/spikes/zephyr/soc/ti/lm3s6965/Kconfig.sysbuild"
osource "/Users/vzein/Projects/spikes/zephyr/soc/ti/k3/Kconfig.sysbuild"
osource "/Users/vzein/Projects/spikes/zephyr/soc/telink/tlsr/Kconfig.sysbuild"
osource "/Users/vzein/Projects/spikes/zephyr/soc/starfive/jh71xx/Kconfig.sysbuild"
osource "/Users/vzein/Projects/spikes/zephyr/soc/st/stm32/Kconfig.sysbuild"
osource "/Users/vzein/Projects/spikes/zephyr/soc/snps/qemu_arc/Kconfig.sysbuild"
osource "/Users/vzein/Projects/spikes/zephyr/soc/snps/nsim/arc_v/Kconfig.sysbuild"
osource "/Users/vzein/Projects/spikes/zephyr/soc/snps/nsim/arc_classic/Kconfig.sysbuild"
osource "/Users/vzein/Projects/spikes/zephyr/soc/snps/hsdk4xd/Kconfig.sysbuild"
osource "/Users/vzein/Projects/spikes/zephyr/soc/snps/hsdk/Kconfig.sysbuild"
osource "/Users/vzein/Projects/spikes/zephyr/soc/snps/emsk/Kconfig.sysbuild"
osource "/Users/vzein/Projects/spikes/zephyr/soc/snps/emsdp/Kconfig.sysbuild"
osource "/Users/vzein/Projects/spikes/zephyr/soc/snps/arc_iot/Kconfig.sysbuild"
osource "/Users/vzein/Projects/spikes/zephyr/soc/silabs/Kconfig.sysbuild"
osource "/Users/vzein/Projects/spikes/zephyr/soc/sifive/sifive_freedom/Kconfig.sysbuild"
osource "/Users/vzein/Projects/spikes/zephyr/soc/sensry/Kconfig.sysbuild"
osource "/Users/vzein/Projects/spikes/zephyr/soc/rockchip/Kconfig.sysbuild"
osource "/Users/vzein/Projects/spikes/zephyr/soc/renode/riscv_virtual/Kconfig.sysbuild"
osource "/Users/vzein/Projects/spikes/zephyr/soc/renode/cortex_r8_virtual/Kconfig.sysbuild"
osource "/Users/vzein/Projects/spikes/zephyr/soc/renesas/smartbond/Kconfig.sysbuild"
osource "/Users/vzein/Projects/spikes/zephyr/soc/renesas/rz/Kconfig.sysbuild"
osource "/Users/vzein/Projects/spikes/zephyr/soc/renesas/rx/Kconfig.sysbuild"
osource "/Users/vzein/Projects/spikes/zephyr/soc/renesas/rcar/Kconfig.sysbuild"
osource "/Users/vzein/Projects/spikes/zephyr/soc/renesas/ra/Kconfig.sysbuild"
osource "/Users/vzein/Projects/spikes/zephyr/soc/realtek/ec/Kconfig.sysbuild"
osource "/Users/vzein/Projects/spikes/zephyr/soc/raspberrypi/rpi_pico/Kconfig.sysbuild"
osource "/Users/vzein/Projects/spikes/zephyr/soc/quicklogic/eos_s3/Kconfig.sysbuild"
osource "/Users/vzein/Projects/spikes/zephyr/soc/qemu/virt_riscv/Kconfig.sysbuild"
osource "/Users/vzein/Projects/spikes/zephyr/soc/qemu/malta/Kconfig.sysbuild"
osource "/Users/vzein/Projects/spikes/zephyr/soc/openisa/rv32m1/Kconfig.sysbuild"
osource "/Users/vzein/Projects/spikes/zephyr/soc/openhwgroup/cva6/Kconfig.sysbuild"
osource "/Users/vzein/Projects/spikes/zephyr/soc/oct/osd32mp15x/Kconfig.sysbuild"
osource "/Users/vzein/Projects/spikes/zephyr/soc/nxp/s32/Kconfig.sysbuild"
osource "/Users/vzein/Projects/spikes/zephyr/soc/nxp/rw/Kconfig.sysbuild"
osource "/Users/vzein/Projects/spikes/zephyr/soc/nxp/mcx/Kconfig.sysbuild"
osource "/Users/vzein/Projects/spikes/zephyr/soc/nxp/lpc/Kconfig.sysbuild"
osource "/Users/vzein/Projects/spikes/zephyr/soc/nxp/layerscape/Kconfig.sysbuild"
osource "/Users/vzein/Projects/spikes/zephyr/soc/nxp/kinetis/Kconfig.sysbuild"
osource "/Users/vzein/Projects/spikes/zephyr/soc/nxp/imxrt/Kconfig.sysbuild"
osource "/Users/vzein/Projects/spikes/zephyr/soc/nxp/imx/Kconfig.sysbuild"
osource "/Users/vzein/Projects/spikes/zephyr/soc/nuvoton/numicro/Kconfig.sysbuild"
osource "/Users/vzein/Projects/spikes/zephyr/soc/nuvoton/numaker/Kconfig.sysbuild"
osource "/Users/vzein/Projects/spikes/zephyr/soc/nuvoton/npcx/Kconfig.sysbuild"
osource "/Users/vzein/Projects/spikes/zephyr/soc/nuvoton/npcm/Kconfig.sysbuild"
osource "/Users/vzein/Projects/spikes/zephyr/soc/nordic/Kconfig.sysbuild"
osource "/Users/vzein/Projects/spikes/zephyr/soc/neorv32/Kconfig.sysbuild"
osource "/Users/vzein/Projects/spikes/zephyr/soc/native/inf_clock/Kconfig.sysbuild"
osource "/Users/vzein/Projects/spikes/zephyr/soc/microchip/sam/Kconfig.sysbuild"
osource "/Users/vzein/Projects/spikes/zephyr/soc/microchip/miv/Kconfig.sysbuild"
osource "/Users/vzein/Projects/spikes/zephyr/soc/microchip/mec/Kconfig.sysbuild"
osource "/Users/vzein/Projects/spikes/zephyr/soc/mediatek/mt8xxx/Kconfig.sysbuild"
osource "/Users/vzein/Projects/spikes/zephyr/soc/lowrisc/opentitan/Kconfig.sysbuild"
osource "/Users/vzein/Projects/spikes/zephyr/soc/litex/litex_vexriscv/Kconfig.sysbuild"
osource "/Users/vzein/Projects/spikes/zephyr/soc/ite/ec/Kconfig.sysbuild"
osource "/Users/vzein/Projects/spikes/zephyr/soc/intel/raptor_lake/Kconfig.sysbuild"
osource "/Users/vzein/Projects/spikes/zephyr/soc/intel/lakemont/Kconfig.sysbuild"
osource "/Users/vzein/Projects/spikes/zephyr/soc/intel/intel_socfpga_std/Kconfig.sysbuild"
osource "/Users/vzein/Projects/spikes/zephyr/soc/intel/intel_socfpga/Kconfig.sysbuild"
osource "/Users/vzein/Projects/spikes/zephyr/soc/intel/intel_niosv/Kconfig.sysbuild"
osource "/Users/vzein/Projects/spikes/zephyr/soc/intel/intel_ish/Kconfig.sysbuild"
osource "/Users/vzein/Projects/spikes/zephyr/soc/intel/intel_adsp/Kconfig.sysbuild"
osource "/Users/vzein/Projects/spikes/zephyr/soc/intel/elkhart_lake/Kconfig.sysbuild"
osource "/Users/vzein/Projects/spikes/zephyr/soc/intel/atom/Kconfig.sysbuild"
osource "/Users/vzein/Projects/spikes/zephyr/soc/intel/apollo_lake/Kconfig.sysbuild"
osource "/Users/vzein/Projects/spikes/zephyr/soc/intel/alder_lake/Kconfig.sysbuild"
osource "/Users/vzein/Projects/spikes/zephyr/soc/infineon/cat3/Kconfig.sysbuild"
osource "/Users/vzein/Projects/spikes/zephyr/soc/infineon/cat1c/Kconfig.sysbuild"
osource "/Users/vzein/Projects/spikes/zephyr/soc/infineon/cat1b/Kconfig.sysbuild"
osource "/Users/vzein/Projects/spikes/zephyr/soc/infineon/cat1a/Kconfig.sysbuild"
osource "/Users/vzein/Projects/spikes/zephyr/soc/gd/gd32/Kconfig.sysbuild"
osource "/Users/vzein/Projects/spikes/zephyr/soc/gaisler/leon3/Kconfig.sysbuild"
osource "/Users/vzein/Projects/spikes/zephyr/soc/gaisler/gr716a/Kconfig.sysbuild"
osource "/Users/vzein/Projects/spikes/zephyr/soc/espressif/Kconfig.sysbuild"
osource "/Users/vzein/Projects/spikes/zephyr/soc/ene/kb1200/Kconfig.sysbuild"
osource "/Users/vzein/Projects/spikes/zephyr/soc/efinix/sapphire/Kconfig.sysbuild"
osource "/Users/vzein/Projects/spikes/zephyr/soc/cdns/xtensa_sample_controller/Kconfig.sysbuild"
osource "/Users/vzein/Projects/spikes/zephyr/soc/cdns/sample_controller32/Kconfig.sysbuild"
osource "/Users/vzein/Projects/spikes/zephyr/soc/cdns/dc233c/Kconfig.sysbuild"
osource "/Users/vzein/Projects/spikes/zephyr/soc/brcm/bcmvk/Kconfig.sysbuild"
osource "/Users/vzein/Projects/spikes/zephyr/soc/brcm/bcm2712/Kconfig.sysbuild"
osource "/Users/vzein/Projects/spikes/zephyr/soc/brcm/bcm2711/Kconfig.sysbuild"
osource "/Users/vzein/Projects/spikes/zephyr/soc/bflb/Kconfig.sysbuild"
osource "/Users/vzein/Projects/spikes/zephyr/soc/atmel/sam0/Kconfig.sysbuild"
osource "/Users/vzein/Projects/spikes/zephyr/soc/atmel/sam/Kconfig.sysbuild"
osource "/Users/vzein/Projects/spikes/zephyr/soc/aspeed/Kconfig.sysbuild"
osource "/Users/vzein/Projects/spikes/zephyr/soc/arm/Kconfig.sysbuild"
osource "/Users/vzein/Projects/spikes/zephyr/soc/arm/beetle/Kconfig.sysbuild"
osource "/Users/vzein/Projects/spikes/zephyr/soc/antmicro/myra/Kconfig.sysbuild"
osource "/Users/vzein/Projects/spikes/zephyr/soc/andestech/Kconfig.sysbuild"
osource "/Users/vzein/Projects/spikes/zephyr/soc/amd/acp_6_0/Kconfig.sysbuild"
osource "/Users/vzein/Projects/spikes/zephyr/soc/ambiq/Kconfig.sysbuild"
osource "/Users/vzein/Projects/spikes/zephyr/soc/aesc/Kconfig.sysbuild"
osource "/Users/vzein/Projects/spikes/zephyr/soc/adi/max32/Kconfig.sysbuild"
```

## west.yml
```yaml
manifest:
  remotes:
    - name: zephyrproject-rtos
      url-base: https://github.com/zephyrproject-rtos
    - name: eclipse-openbsw
      url-base: https://github.com/eclipse-openbsw
    - name: vtz
      url-base: https://github.com/vtz

  projects:
    - name: zephyr
      remote: zephyrproject-rtos
      revision: ea6eade52b595b064af8bc232d26dc3b67eb9a6d
      import:
        name-allowlist:
          - cmsis
          - cmsis_6
          - hal_stm32
          - net-tools
          - segger

    - name: openbsw
      remote: eclipse-openbsw
      revision: 82397e004ee1d8bd38426c5d25239bf986146ce5

    - name: openbsw-zephyr
      remote: eclipse-openbsw
      revision: c1fc544f5a41f4319152fd643c8ff0e3d662806c
      path: modules/openbsw-zephyr

    - name: opensomeip
      remote: vtz
      revision: v0.0.5
      path: modules/opensomeip

  self:
    path: body-ecu
```
