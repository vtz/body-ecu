## build_h755/Kconfig/Kconfig.modules
```kconfig
menu "someip-stack (/Users/vzein/Projects/spikes/modules/opensomeip)"
osource "/Users/vzein/Projects/spikes/modules/opensomeip/zephyr/Kconfig"
config ZEPHYR_SOMEIP_STACK_MODULE
	bool
	default y
endmenu
menu "cmsis (/Users/vzein/Projects/spikes/modules/hal/cmsis)"
osource "$(ZEPHYR_CMSIS_KCONFIG)"
config ZEPHYR_CMSIS_MODULE
	bool
	default y
endmenu
menu "cmsis_6 (/Users/vzein/Projects/spikes/modules/hal/cmsis_6)"
osource "$(ZEPHYR_CMSIS_6_KCONFIG)"
config ZEPHYR_CMSIS_6_MODULE
	bool
	default y
endmenu
config ZEPHYR_HAL_STM32_MODULE
	bool
	default y

config ZEPHYR_HAL_STM32_MODULE_BLOBS
	bool
menu "segger (/Users/vzein/Projects/spikes/modules/debug/segger)"
osource "$(ZEPHYR_SEGGER_KCONFIG)"
config ZEPHYR_SEGGER_MODULE
	bool
	default y
endmenu
```

## build_h755/Kconfig/Kconfig.sysbuild.modules
```kconfig
config ZEPHYR_SOMEIP_STACK_MODULE
   bool
   default y
config ZEPHYR_CMSIS_MODULE
   bool
   default y
config ZEPHYR_CMSIS_6_MODULE
   bool
   default y
config ZEPHYR_HAL_STM32_MODULE
   bool
   default y
config ZEPHYR_SEGGER_MODULE
   bool
   default y
```

## build_h755/Kconfig/arch/Kconfig
```kconfig
# Load Zephyr Arch Kconfig descriptions.
osource "/Users/vzein/Projects/spikes/zephyr/arch/rx/Kconfig"
osource "/Users/vzein/Projects/spikes/zephyr/arch/x86/Kconfig"
osource "/Users/vzein/Projects/spikes/zephyr/arch/xtensa/Kconfig"
osource "/Users/vzein/Projects/spikes/zephyr/arch/sparc/Kconfig"
osource "/Users/vzein/Projects/spikes/zephyr/arch/riscv/Kconfig"
osource "/Users/vzein/Projects/spikes/zephyr/arch/posix/Kconfig"
osource "/Users/vzein/Projects/spikes/zephyr/arch/mips/Kconfig"
osource "/Users/vzein/Projects/spikes/zephyr/arch/arm64/Kconfig"
osource "/Users/vzein/Projects/spikes/zephyr/arch/arm/Kconfig"
osource "/Users/vzein/Projects/spikes/zephyr/arch/arc/Kconfig"
```

## build_h755/Kconfig/boards/Kconfig.defconfig
```kconfig
# Load Zephyr board defconfig descriptions.
osource "/Users/vzein/Projects/spikes/zephyr/boards/st/nucleo_h755zi_q/Kconfig.defconfig"
```

## build_h755/Kconfig/boards/Kconfig.nucleo_h755zi_q
```kconfig
# Load board Kconfig descriptions.
osource "/Users/vzein/Projects/spikes/zephyr/boards/st/nucleo_h755zi_q/Kconfig.nucleo_h755zi_q"
```

## build_h755/Kconfig/boards/Kconfig.sysbuild
```kconfig
# Load Sysbuild board Kconfig descriptions.
osource "/Users/vzein/Projects/spikes/zephyr/boards/st/nucleo_h755zi_q/Kconfig.sysbuild"
```

## build_h755/Kconfig/soc/Kconfig
```kconfig
# Load Zephyr SoC Kconfig descriptions.
osource "/Users/vzein/Projects/spikes/zephyr/soc/xlnx/zynqmp/Kconfig"
osource "/Users/vzein/Projects/spikes/zephyr/soc/xlnx/zynq7000/Kconfig"
osource "/Users/vzein/Projects/spikes/zephyr/soc/xlnx/versalnet/Kconfig"
osource "/Users/vzein/Projects/spikes/zephyr/soc/xlnx/versal2/Kconfig"
osource "/Users/vzein/Projects/spikes/zephyr/soc/xen/Kconfig"
osource "/Users/vzein/Projects/spikes/zephyr/soc/wch/ch32v/Kconfig"
osource "/Users/vzein/Projects/spikes/zephyr/soc/ti/simplelink/Kconfig"
osource "/Users/vzein/Projects/spikes/zephyr/soc/ti/mspm0/Kconfig"
osource "/Users/vzein/Projects/spikes/zephyr/soc/ti/lm3s6965/Kconfig"
osource "/Users/vzein/Projects/spikes/zephyr/soc/ti/k3/Kconfig"
osource "/Users/vzein/Projects/spikes/zephyr/soc/telink/tlsr/Kconfig"
osource "/Users/vzein/Projects/spikes/zephyr/soc/starfive/jh71xx/Kconfig"
osource "/Users/vzein/Projects/spikes/zephyr/soc/st/stm32/Kconfig"
osource "/Users/vzein/Projects/spikes/zephyr/soc/snps/qemu_arc/Kconfig"
osource "/Users/vzein/Projects/spikes/zephyr/soc/snps/nsim/arc_v/Kconfig"
osource "/Users/vzein/Projects/spikes/zephyr/soc/snps/nsim/arc_classic/Kconfig"
osource "/Users/vzein/Projects/spikes/zephyr/soc/snps/hsdk4xd/Kconfig"
osource "/Users/vzein/Projects/spikes/zephyr/soc/snps/hsdk/Kconfig"
osource "/Users/vzein/Projects/spikes/zephyr/soc/snps/emsk/Kconfig"
osource "/Users/vzein/Projects/spikes/zephyr/soc/snps/emsdp/Kconfig"
osource "/Users/vzein/Projects/spikes/zephyr/soc/snps/arc_iot/Kconfig"
osource "/Users/vzein/Projects/spikes/zephyr/soc/silabs/Kconfig"
osource "/Users/vzein/Projects/spikes/zephyr/soc/sifive/sifive_freedom/Kconfig"
osource "/Users/vzein/Projects/spikes/zephyr/soc/sensry/Kconfig"
osource "/Users/vzein/Projects/spikes/zephyr/soc/rockchip/Kconfig"
osource "/Users/vzein/Projects/spikes/zephyr/soc/renode/riscv_virtual/Kconfig"
osource "/Users/vzein/Projects/spikes/zephyr/soc/renode/cortex_r8_virtual/Kconfig"
osource "/Users/vzein/Projects/spikes/zephyr/soc/renesas/smartbond/Kconfig"
osource "/Users/vzein/Projects/spikes/zephyr/soc/renesas/rz/Kconfig"
osource "/Users/vzein/Projects/spikes/zephyr/soc/renesas/rx/Kconfig"
osource "/Users/vzein/Projects/spikes/zephyr/soc/renesas/rcar/Kconfig"
osource "/Users/vzein/Projects/spikes/zephyr/soc/renesas/ra/Kconfig"
osource "/Users/vzein/Projects/spikes/zephyr/soc/realtek/ec/Kconfig"
osource "/Users/vzein/Projects/spikes/zephyr/soc/raspberrypi/rpi_pico/Kconfig"
osource "/Users/vzein/Projects/spikes/zephyr/soc/quicklogic/eos_s3/Kconfig"
osource "/Users/vzein/Projects/spikes/zephyr/soc/qemu/virt_riscv/Kconfig"
osource "/Users/vzein/Projects/spikes/zephyr/soc/qemu/malta/Kconfig"
osource "/Users/vzein/Projects/spikes/zephyr/soc/openisa/rv32m1/Kconfig"
osource "/Users/vzein/Projects/spikes/zephyr/soc/openhwgroup/cva6/Kconfig"
osource "/Users/vzein/Projects/spikes/zephyr/soc/oct/osd32mp15x/Kconfig"
osource "/Users/vzein/Projects/spikes/zephyr/soc/nxp/s32/Kconfig"
osource "/Users/vzein/Projects/spikes/zephyr/soc/nxp/rw/Kconfig"
osource "/Users/vzein/Projects/spikes/zephyr/soc/nxp/mcx/Kconfig"
osource "/Users/vzein/Projects/spikes/zephyr/soc/nxp/lpc/Kconfig"
osource "/Users/vzein/Projects/spikes/zephyr/soc/nxp/layerscape/Kconfig"
osource "/Users/vzein/Projects/spikes/zephyr/soc/nxp/kinetis/Kconfig"
osource "/Users/vzein/Projects/spikes/zephyr/soc/nxp/imxrt/Kconfig"
osource "/Users/vzein/Projects/spikes/zephyr/soc/nxp/imx/Kconfig"
osource "/Users/vzein/Projects/spikes/zephyr/soc/nuvoton/numicro/Kconfig"
osource "/Users/vzein/Projects/spikes/zephyr/soc/nuvoton/numaker/Kconfig"
osource "/Users/vzein/Projects/spikes/zephyr/soc/nuvoton/npcx/Kconfig"
osource "/Users/vzein/Projects/spikes/zephyr/soc/nuvoton/npcm/Kconfig"
osource "/Users/vzein/Projects/spikes/zephyr/soc/nordic/Kconfig"
osource "/Users/vzein/Projects/spikes/zephyr/soc/neorv32/Kconfig"
osource "/Users/vzein/Projects/spikes/zephyr/soc/native/inf_clock/Kconfig"
osource "/Users/vzein/Projects/spikes/zephyr/soc/microchip/sam/Kconfig"
osource "/Users/vzein/Projects/spikes/zephyr/soc/microchip/miv/Kconfig"
osource "/Users/vzein/Projects/spikes/zephyr/soc/microchip/mec/Kconfig"
osource "/Users/vzein/Projects/spikes/zephyr/soc/mediatek/mt8xxx/Kconfig"
osource "/Users/vzein/Projects/spikes/zephyr/soc/lowrisc/opentitan/Kconfig"
osource "/Users/vzein/Projects/spikes/zephyr/soc/litex/litex_vexriscv/Kconfig"
osource "/Users/vzein/Projects/spikes/zephyr/soc/ite/ec/Kconfig"
osource "/Users/vzein/Projects/spikes/zephyr/soc/intel/raptor_lake/Kconfig"
osource "/Users/vzein/Projects/spikes/zephyr/soc/intel/lakemont/Kconfig"
osource "/Users/vzein/Projects/spikes/zephyr/soc/intel/intel_socfpga_std/Kconfig"
osource "/Users/vzein/Projects/spikes/zephyr/soc/intel/intel_socfpga/Kconfig"
osource "/Users/vzein/Projects/spikes/zephyr/soc/intel/intel_niosv/Kconfig"
osource "/Users/vzein/Projects/spikes/zephyr/soc/intel/intel_ish/Kconfig"
osource "/Users/vzein/Projects/spikes/zephyr/soc/intel/intel_adsp/Kconfig"
osource "/Users/vzein/Projects/spikes/zephyr/soc/intel/elkhart_lake/Kconfig"
osource "/Users/vzein/Projects/spikes/zephyr/soc/intel/atom/Kconfig"
osource "/Users/vzein/Projects/spikes/zephyr/soc/intel/apollo_lake/Kconfig"
osource "/Users/vzein/Projects/spikes/zephyr/soc/intel/alder_lake/Kconfig"
osource "/Users/vzein/Projects/spikes/zephyr/soc/infineon/cat3/Kconfig"
osource "/Users/vzein/Projects/spikes/zephyr/soc/infineon/cat1c/Kconfig"
osource "/Users/vzein/Projects/spikes/zephyr/soc/infineon/cat1b/Kconfig"
osource "/Users/vzein/Projects/spikes/zephyr/soc/infineon/cat1a/Kconfig"
osource "/Users/vzein/Projects/spikes/zephyr/soc/gd/gd32/Kconfig"
osource "/Users/vzein/Projects/spikes/zephyr/soc/gaisler/leon3/Kconfig"
osource "/Users/vzein/Projects/spikes/zephyr/soc/gaisler/gr716a/Kconfig"
osource "/Users/vzein/Projects/spikes/zephyr/soc/espressif/Kconfig"
osource "/Users/vzein/Projects/spikes/zephyr/soc/ene/kb1200/Kconfig"
osource "/Users/vzein/Projects/spikes/zephyr/soc/efinix/sapphire/Kconfig"
osource "/Users/vzein/Projects/spikes/zephyr/soc/cdns/xtensa_sample_controller/Kconfig"
osource "/Users/vzein/Projects/spikes/zephyr/soc/cdns/sample_controller32/Kconfig"
osource "/Users/vzein/Projects/spikes/zephyr/soc/cdns/dc233c/Kconfig"
osource "/Users/vzein/Projects/spikes/zephyr/soc/brcm/bcmvk/Kconfig"
osource "/Users/vzein/Projects/spikes/zephyr/soc/brcm/bcm2712/Kconfig"
osource "/Users/vzein/Projects/spikes/zephyr/soc/brcm/bcm2711/Kconfig"
osource "/Users/vzein/Projects/spikes/zephyr/soc/bflb/Kconfig"
osource "/Users/vzein/Projects/spikes/zephyr/soc/atmel/sam0/Kconfig"
osource "/Users/vzein/Projects/spikes/zephyr/soc/atmel/sam/Kconfig"
osource "/Users/vzein/Projects/spikes/zephyr/soc/aspeed/Kconfig"
osource "/Users/vzein/Projects/spikes/zephyr/soc/arm/Kconfig"
osource "/Users/vzein/Projects/spikes/zephyr/soc/arm/beetle/Kconfig"
osource "/Users/vzein/Projects/spikes/zephyr/soc/antmicro/myra/Kconfig"
osource "/Users/vzein/Projects/spikes/zephyr/soc/andestech/Kconfig"
osource "/Users/vzein/Projects/spikes/zephyr/soc/amd/acp_6_0/Kconfig"
osource "/Users/vzein/Projects/spikes/zephyr/soc/ambiq/Kconfig"
osource "/Users/vzein/Projects/spikes/zephyr/soc/aesc/Kconfig"
osource "/Users/vzein/Projects/spikes/zephyr/soc/adi/max32/Kconfig"
```
